# file: led_blink.ioc
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Mcu.Family=STM32C0
Mcu.Name=STM32C011F(4-6)Px
Mcu.Package=TSSOP20
PA13.Mode=Serial_Wire
PA13.Signal=DEBUG_SWDIO
PA14-BOOT0.Mode=Serial_Wire
PA14-BOOT0.Signal=DEBUG_SWCLK
PA4.GPIO_Label=LED
PA4.Signal=GPIO_Output
ProjectManager.HeapSize=0x200
ProjectManager.StackSize=0x400
ProjectManager.TargetToolchain=STM32CubeIDE
RCC.ADCFreq_Value=12000000
RCC.AHBFreq_Value=12000000
RCC.CortexFreq_Value=12000000
RCC.EXTERNAL_CLOCK_VALUE=12288000
RCC.HCLKFreq_Value=12000000
RCC.HSE_VALUE=8000000
RCC.HSI_VALUE=48000000
RCC.LSE_VALUE=32768
RCC.SYSCLKFreq_VALUE=12000000
board=custom

// file: Core/Src/main.c
/* USER CODE BEGIN Header */
/**
 ******************************************************************************
 * @file           : main.c
 * @brief          : Main program body
 ******************************************************************************
 * @attention
 *
 * Copyright (c) 2024 STMicroelectronics.
 * All rights reserved.
 *
 * This software is licensed under terms that can be found in the LICENSE file
 * in the root directory of this software component.
 * If no LICENSE file comes with this software, it is provided AS-IS.
 *
 ******************************************************************************
 */
/* USER CODE END Header */
#include "main.h"

/* USER CODE BEGIN Includes */
#include "FLASH_PAGE_C0.h"
#include "string.h"
#include "stdio.h"
/* USER CODE END Includes */

void SystemClock_Config(void);
static void MX_GPIO_Init(void);

/* USER CODE BEGIN 0 */
char *data = "hello i read from flash";
int int_data = 123;
float float_data = 123.456;
char char_data = 'A';
uint32_t Rx_Data[30];
char string[100];
void write_flash(uint32_t address, uint8_t *data, uint32_t length) {
	HAL_FLASH_Unlock();

	for (uint32_t i = 0; i < length; i++) {
		HAL_FLASH_Program(FLASH_TYPEPROGRAM_DOUBLEWORD, address + i, data[i]);
	}

	HAL_FLASH_Lock();
}

void write_flash_int(uint32_t address, int data) {
	uint8_t bytes[4];
	memcpy(bytes, &data, sizeof(data));
	write_flash(address, bytes, sizeof(bytes));
}

void write_flash_float(uint32_t address, float data) {
	uint8_t bytes[4];
	memcpy(bytes, &data, sizeof(data));
	write_flash(address, bytes, sizeof(bytes));
}

void write_flash_char(uint32_t address, char data) {
	write_flash(address, (uint8_t *)&data, sizeof(data));
}

/* USER CODE END 0 */

int main(void)
{

	/* MCU Configuration--------------------------------------------------------*/

	/* Reset of all peripherals, Initializes the Flash interface and the Systick. */
	HAL_Init();

	/* Configure the system clock */
	SystemClock_Config();

	/* Initialize all configured peripherals */
	MX_GPIO_Init();
	/* USER CODE BEGIN 2 */
	HAL_FLASH_Unlock();

	//	// เขียนข้อมูลลงแฟลชที่หน้า 0x08007000
	//	for (int i = 0; i < sizeof(data2)/sizeof(data2[0]); i++) {
	//	    HAL_FLASH_Program(FLASH_TYPEPROGRAM_DOUBLEWORD, 0x08007000 + (i * 4), data2[i]);
	//	}
	//
	//	for (int i = 0; i < sizeof(data3)/sizeof(data3[0]); i++) {
	//	    HAL_FLASH_Program(FLASH_TYPEPROGRAM_DOUBLEWORD, 0x08007000 + (sizeof(data2) * 4) + (i * 4), data3[i]);
	//	}
	//    uint32_t start_address = 0x08007100; // ที่อยู่เริ่มต้นของแฟลชที่ต้องการเขียน

	// เขียนข้อมูลตัวอักษรลงแฟลช
	// write_flash(start_address, (uint8_t *)data, strlen(data) + 1); // +1 เพื่อเขียน null terminator ด้วย
	uint32_t start_address = 0x08007000;

	// เขียนข้อมูลประเภท string
	write_flash(start_address, (uint8_t *)data, strlen(data) + 1);

	// เขียนข้อมูลประเภท int
	start_address += strlen(data) + 1;
	write_flash_int(start_address, int_data);

	// เขียนข้อมูลประเภท float
	start_address += sizeof(int);
write_flash_float(start_address, float_data);

	// เขียนข้อมูลประเภท char
	start_address += sizeof(float);
	write_flash_char(start_address, char_data);

	HAL_FLASH_Lock();
	/* USER CODE END 2 */

	/* Infinite loop */
	while (1)
	{

	}
}

void SystemClock_Config(void)
{
	RCC_OscInitTypeDef RCC_OscInitStruct = {0};
	RCC_ClkInitTypeDef RCC_ClkInitStruct = {0};

	/** Initializes the RCC Oscillators according to the specified parameters
	 * in the RCC_OscInitTypeDef structure.
	 */
	RCC_OscInitStruct.OscillatorType = RCC_OSCILLATORTYPE_HSI;
	RCC_OscInitStruct.HSIState = RCC_HSI_ON;
	RCC_OscInitStruct.HSIDiv = RCC_HSI_DIV4;
	RCC_OscInitStruct.HSICalibrationValue = RCC_HSICALIBRATION_DEFAULT;
	if (HAL_RCC_OscConfig(&RCC_OscInitStruct) != HAL_OK)
	{
		Error_Handler();
	}

	/** Initializes the CPU, AHB and APB buses clocks
	 */
	RCC_ClkInitStruct.ClockType = RCC_CLOCKTYPE_HCLK|RCC_CLOCKTYPE_SYSCLK
			|RCC_CLOCKTYPE_PCLK1;
	RCC_ClkInitStruct.SYSCLKSource = RCC_SYSCLKSOURCE_HSI;
	RCC_ClkInitStruct.SYSCLKDivider = RCC_SYSCLK_DIV1;
	RCC_ClkInitStruct.AHBCLKDivider = RCC_HCLK_DIV1;
	RCC_ClkInitStruct.APB1CLKDivider = RCC_APB1_DIV1;

	if (HAL_RCC_ClockConfig(&RCC_ClkInitStruct, FLASH_LATENCY_0) != HAL_OK)
	{
		Error_Handler();
	}
}

static void MX_GPIO_Init(void)
{
	GPIO_InitTypeDef GPIO_InitStruct = {0};

	/* GPIO Ports Clock Enable */
	__HAL_RCC_GPIOA_CLK_ENABLE();

	/*Configure GPIO pin Output Level */
	HAL_GPIO_WritePin(LED_GPIO_Port, LED_Pin, GPIO_PIN_RESET);

	/*Configure GPIO pin : LED_Pin */
	GPIO_InitStruct.Pin = LED_Pin;
	GPIO_InitStruct.Mode = GPIO_MODE_OUTPUT_PP;
	GPIO_InitStruct.Pull = GPIO_NOPULL;
	GPIO_InitStruct.Speed = GPIO_SPEED_FREQ_LOW;
	HAL_GPIO_Init(LED_GPIO_Port, &GPIO_InitStruct);

}

void Error_Handler(void)
{
	__disable_irq();
	while (1)
	{
	}
}
